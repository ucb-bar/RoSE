## soc/sw/zephyr-rose/Kconfig
```kconfig
# RoSE Zephyr module configuration.
rsource "drivers/Kconfig"
rsource "subsys/Kconfig"
```

## soc/sw/zephyr-rose/drivers/rose/Kconfig
```kconfig
config ROSE
	bool "RoSE co-simulation bridge adapter driver"
	default y
	depends on DT_HAS_UCBBAR_ROSEADAPTER_ENABLED
	help
	  Enable the driver for the RoSE co-simulation bridge adapter
	  (compatible "ucbbar,RoseAdapter"). Provides a device-model API
	  (rose_tx / rose_rx) over the adapter's TX/RX FIFOs. This initial
	  version is polling-only; DMA + interrupt support is added later.
```

## soc/sw/zephyr-rose/dts/bindings/misc/ucbbar,RoseAdapter.yaml
```yaml
# Copyright (c) 2026 UC Berkeley
# SPDX-License-Identifier: Apache-2.0

description: |
  UC Berkeley RoSE co-simulation bridge adapter.

  A TileLink MMIO peripheral exposing a TX FIFO, per-channel RX FIFOs
  (reqrsp) and camera-DMA channels (which write to system memory and raise a
  completion interrupt). See soc/sw/generated-src/rose_c_header/rose_port.h
  for the generated register map.

compatible: "ucbbar,RoseAdapter"

include: base.yaml

properties:
  reg:
    required: true

  interrupts:
    required: false
    description: DMA-completion interrupt(s), one per DMA channel.

  num-reqrsp-channels:
    type: int
    default: 2
    description: Number of reqrsp (MMIO-read) RX channels.

  num-dma-channels:
    type: int
    default: 1
    description: Number of camera-DMA channels.

  dma-base-address:
    type: int
    description: |
      Physical base address in system memory that the camera-DMA engine
      writes filled buffers to (channel 0 target; e.g. 0x88000000).
```

## soc/sw/zephyr-rose/subsys/rose/Kconfig
```kconfig
config ROSE_PROTOCOL
	bool "RoSE co-simulation protocol/transport layer"
	default y
	depends on ROSE
	help
	  Transport-neutral RoSE packet protocol layer (request/response framing,
	  command set) on top of the RoSE adapter driver. Used by higher-level
	  shims (rose-i2c bus, rose sensor drivers) so the same user-facing API
	  works in co-sim or on real hardware.
```
