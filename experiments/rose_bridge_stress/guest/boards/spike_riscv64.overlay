/* RoSE co-sim adapter node (control MMIO @0x2000, DMA-complete IRQ = PLIC source 3). */
/ {
	rose0: rose@2000 {
		compatible = "ucbbar,RoseAdapter";
		reg = <0x2000 0x1000>;
		interrupt-parent = <&plic>;
		interrupts = <3 1>;
		num-reqrsp-channels = <2>;
		num-dma-channels = <1>;
		dma-base-address = <0x88000000>;
		status = "okay";
	};
};
